## sdkconfig.defaults
```kconfig
# PSRAM
CONFIG_SPIRAM_SUPPORT=y
CONFIG_SPIRAM_BOOT_INIT=y
CONFIG_SPIRAM_USE_CAPS_ALLOC=y
CONFIG_SPIRAM_USE_MALLOC=y
CONFIG_SPIRAM_TYPE_AUTO=y

# Flash
CONFIG_ESPTOOLPY_FLASHMODE_QIO=y
CONFIG_ESPTOOLPY_FLASHFREQ_80M=y
CONFIG_ESPTOOLPY_FLASHSIZE_16MB=y

# USB (we mostly rely on UART, but keep USB enabled)
CONFIG_TINYUSB_SUPPORT=y
CONFIG_ESP_CONSOLE_USB_SERIAL_JTAG=y

# Logging
CONFIG_LOG_DEFAULT_LEVEL_INFO=y
```
